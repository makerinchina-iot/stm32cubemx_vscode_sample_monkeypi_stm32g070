/* USER CODE BEGIN Header */
/**
 ******************************************************************************
 * @file           : main.c
 * @brief          : Main program body
 ******************************************************************************
 * @attention
 *
 * Copyright (c) 2025 STMicroelectronics.
 * All rights reserved.
 *
 * This software is licensed under terms that can be found in the LICENSE file
 * in the root directory of this software component.
 * If no LICENSE file comes with this software, it is provided AS-IS.
 *
 ******************************************************************************
 */
/* USER CODE END Header */
/* Includes ------------------------------------------------------------------*/
#include "main.h"
#include "spi.h"
#include "gpio.h"

/* Private includes ----------------------------------------------------------*/
/* USER CODE BEGIN Includes */
#include "log.h"
#include "sgl.h"
#include "xpt2046.h"
#include "st7789.h"

/* USER CODE END Includes */

/* Private typedef -----------------------------------------------------------*/
/* USER CODE BEGIN PTD */

/* USER CODE END PTD */

/* Private define ------------------------------------------------------------*/
/* USER CODE BEGIN PD */

/* USER CODE END PD */

/* Private macro -------------------------------------------------------------*/
/* USER CODE BEGIN PM */

/* USER CODE END PM */

/* Private variables ---------------------------------------------------------*/

/* USER CODE BEGIN PV */
#define PANEL_WIDTH 240
#define PANEL_HEIGHT 320

sgl_color_t panel_buffer[PANEL_WIDTH * 10];

#define CLR_BG_BASE sgl_rgb(0x0A, 0x0E, 0x17)
#define CLR_CARD_BG sgl_rgb(0x1a, 0x1e, 0x1b)
#define CLR_DIVIDER sgl_rgb(0x1D, 0x27, 0x2B)
#define CLR_CYBER_BLUE sgl_rgb(0x00, 0xF3, 0xFF)
#define CLR_NEON_GREEN sgl_rgb(0x00, 0xFF, 0x66)
#define CLR_PLOT_BG sgl_rgb(0x12, 0x10, 0x0b)
#define CLR_MAGENTA sgl_rgb(0xFF, 0x00, 0xFF)
#define CLR_TEXT_GRAY sgl_rgb(0x6B, 0x7B, 0x93)
#define CLR_TEXT sgl_rgb(0xa0, 0xaB, 0xa3)
#define CLR_WHITE sgl_rgb(0xFF, 0xFF, 0xFF)

/* USER CODE END PV */

/* Private function prototypes -----------------------------------------------*/
void SystemClock_Config(void);
/* USER CODE BEGIN PFP */

/* USER CODE END PFP */

/* Private user code ---------------------------------------------------------*/
/* USER CODE BEGIN 0 */
void tft_panel_flush_area(sgl_area_t *area, sgl_color_t *src)
{

    int16_t x1 = area->x1;
    int16_t y1 = area->y1;
    int16_t x2 = area->x2;
    int16_t y2 = area->y2;

    const uint16_t w = x2 - x1 + 1;
    const uint16_t h = y2 - y1 + 1;

    // tft flush win
    // log_debug("draw pos: %d, %d, %d, %d", x1, y1, x2, y2);

    st7789_fill_area(x1, y1, w, h, (uint16_t *)src);

    sgl_fbdev_flush_ready();
}

static uint16_t pos_x = 0;
static uint16_t pos_y = 0;

void touch_read_event()
{
    bool touch_status = xpt2046_touched();

    xpt2046_get_pos(&pos_x, &pos_y);

    sgl_event_pos_input(pos_x, pos_y, touch_status);

    // log_debug("touch pos [%d] :%d,%d", touch_status, pos_x, pos_y);
}

void sgl_debug_print(const char *str)
{
    // log_debug(str);
    SEGGER_RTT_printf(0, "%s", str);
}

static const uint8_t icon_light_pixmap[] = {
    0x00,
    0x00,
    0x00,
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    0x00,
};

static sgl_icon_pixmap_t icon_light = {
    .bitmap = icon_light_pixmap,
    .width = 42,
    .height = 42,
};

static const uint8_t icon_lock_pixmap[] = {
    0x00,
    0x00,
    0x00,
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    0x00,
};

static sgl_icon_pixmap_t icon_lock = {
    .bitmap = icon_lock_pixmap,
    .width = 32,
    .height = 32,
};

static const uint8_t icon_fan_pixmap[] = {
    0x00,
    0x00,
    0x00,
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    0x00,
};

static sgl_icon_pixmap_t icon_fan = {
    .bitmap = icon_fan_pixmap,
    .width = 32,
    .height = 32,
};

static const uint8_t icon_fan30_pixmap[] = {
    0x00,
    0x00,
    0x00,
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    0x00,
};

static sgl_icon_pixmap_t icon_fan30 = {
    .bitmap = icon_fan30_pixmap,
    .width = 32,
    .height = 32,
};
static const uint8_t icon_fan60_pixmap[] = {
    0x00,
    0x00,
    0x00,
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    0x00,
};

static sgl_icon_pixmap_t icon_fan60 = {
    .bitmap = icon_fan60_pixmap,
    .width = 32,
    .height = 32,
};

static sgl_obj_t *icon_light_r = NULL;
static sgl_obj_t *fan_r = NULL;
static sgl_obj_t *lock_r = NULL;

static bool g_fan_state = false;
static bool g_lock_state = false;

static uint32_t g_time_value = 0;
static int g_temp_value = 235;
static int g_humi_value = 542;

#define PLOT_BUFF_LEN 32
static int16_t g_plot_buff0[PLOT_BUFF_LEN] = {0};
static int16_t g_plot_value = 0;

char buff[16] = {0};

void light_cb(sgl_event_t *e)
{
    sgl_obj_t *light_val = (sgl_obj_t *)(e->param);

    uint8_t s_value = sgl_slider_get_value(e->obj);

    uint8_t brightness = s_value * 255 / 100;

    log_debug("slider val: %d", s_value);

    sprintf(buff, "%d", s_value);
    sgl_label_set_text(light_val, buff);
    sgl_icon_set_color(icon_light_r, sgl_rgb(brightness, brightness, brightness));

    if (e->type == SGL_EVENT_PRESSED)
    {
        // log_info("sgl event press");
    }
    else if (e->type == SGL_EVENT_RELEASED)
    {
        // log_info("sgl event release");

        log_info("light value : %d", s_value);
    }
}

sgl_anim_t *fan_anim = NULL;

sgl_icon_pixmap_t *fan_icons[3] = {&icon_fan, &icon_fan30, &icon_fan60};

void fan_anim_cb(sgl_anim_t *anim, int32_t val)
{
    sgl_obj_t *ico_fan = (sgl_obj_t *)(anim->data);

    // log_debug("anim val: %d", val);
    if ((val >= 0) && (val <= 2))
    {
        sgl_icon_set_icon(ico_fan, fan_icons[val]);
    }
}

void fan_click_cb(sgl_event_t *e)
{
    sgl_obj_t *fan_icon_r = (sgl_obj_t *)(e->param);
    if (e->type == SGL_EVENT_PRESSED)
    {
        // log_info("sgl event press");
        sgl_rect_set_border_color(fan_r, CLR_WHITE);
        sgl_icon_set_color(fan_icon_r, CLR_CYBER_BLUE);
    }
    else if (e->type == SGL_EVENT_RELEASED)
    {
        // log_info("sgl event release");

        g_fan_state = !g_fan_state;

        if (g_fan_state)
        {
            sgl_rect_set_border_color(fan_r, CLR_CYBER_BLUE);
            sgl_icon_set_color(fan_icon_r, CLR_CYBER_BLUE);

            // fan is running
            sgl_anim_start(fan_anim, SGL_ANIM_REPEAT_LOOP);
        }
        else
        {
            sgl_rect_set_border_color(fan_r, CLR_DIVIDER);
            sgl_icon_set_color(fan_icon_r, CLR_TEXT_GRAY);

            sgl_anim_stop(fan_anim);
        }

        log_info("fan state : %d", g_fan_state);
    }
}

void lock_click_cb(sgl_event_t *e)
{
    sgl_obj_t *lock_icon_r = (sgl_obj_t *)(e->param);
    if (e->type == SGL_EVENT_PRESSED)
    {
        // log_info("sgl event press");
        sgl_rect_set_border_color(lock_r, CLR_WHITE);
        sgl_icon_set_color(lock_icon_r, CLR_CYBER_BLUE);
    }
    else if (e->type == SGL_EVENT_RELEASED)
    {
        // log_info("sgl event release");

        g_lock_state = !g_lock_state;

        if (g_lock_state)
        {
            sgl_rect_set_border_color(lock_r, CLR_CYBER_BLUE);
            sgl_icon_set_color(lock_icon_r, CLR_CYBER_BLUE);
        }
        else
        {
            sgl_rect_set_border_color(lock_r, CLR_DIVIDER);
            sgl_icon_set_color(lock_icon_r, CLR_TEXT_GRAY);
        }

        log_info("lock state : %d", g_lock_state);
    }
}

/* USER CODE END 0 */

/**
 * @brief  The application entry point.
 * @retval int
 */
int main(void)
{

    /* USER CODE BEGIN 1 */

    /* USER CODE END 1 */

    /* MCU Configuration--------------------------------------------------------*/

    /* Reset of all peripherals, Initializes the Flash interface and the Systick. */
    HAL_Init();

    /* USER CODE BEGIN Init */

    /* USER CODE END Init */

    /* Configure the system clock */
    SystemClock_Config();

    /* USER CODE BEGIN SysInit */

    /* USER CODE END SysInit */

    /* Initialize all configured peripherals */
    MX_GPIO_Init();
    MX_SPI1_Init();
    /* USER CODE BEGIN 2 */
    log_init(LOG_DEBUG, false);

    log_debug("tft and touch init and test.");
    st7789_init();
    xpt2046_init();

    // st7789_fill_rect(0, 0, 240, 320, GREEN);
    // HAL_Delay(3000);
    st7789_fill_rect(0, 0, 240, 320, BLACK);
    // HAL_Delay(3000);

    log_debug("test lcd done.");

    log_debug("sgl init.");

    sgl_fbinfo_t fbinfo = {
        .xres = PANEL_WIDTH,
        .yres = PANEL_HEIGHT,
        .flush_area = tft_panel_flush_area,
        .buffer[0] = panel_buffer,
        .buffer_size = SGL_ARRAY_SIZE(panel_buffer),
    };
    sgl_fbdev_register(&fbinfo);

    sgl_logdev_register(sgl_debug_print);

    sgl_init();
    log_debug("sgl init done.");

    // HAL_Delay(1000);

    SGL_LOG_INFO("sgl debug enable.");

    log_debug("create sgl gui.");

    // value init

    const char build_time[] = __TIME__; // "HH:MM:SS"
    int h, m, s;
    sscanf(build_time, "%d:%d:%d", &h, &m, &s);
    g_time_value = h * 3600 + m * 60 + s;
    log_debug("start time: %s,%d ", build_time, g_time_value);

    /////////////////////////////////////
    // ---------------------------------------------------------
    // 0. 根页面初始化
    // ---------------------------------------------------------
    sgl_obj_t *root_page = sgl_obj_create(NULL);
    sgl_screen_load(root_page);
    sgl_page_set_color(root_page, CLR_BG_BASE); // 设置底层背景

    // ---------------------------------------------------------
    // 1. Header 顶部状态栏
    // ---------------------------------------------------------
    sgl_obj_t *dot_status = sgl_label_create(root_page);
    sgl_label_set_text(dot_status, "");
    sgl_label_set_font(dot_status, &consolas14);
    sgl_obj_set_size(dot_status, 8, 8);
    sgl_obj_set_pos(dot_status, 10, 10);
    sgl_label_set_bg_color(dot_status, CLR_CYBER_BLUE);
    sgl_label_set_radius(dot_status, 4);

    sgl_obj_t *lbl_link = sgl_label_create(root_page);
    sgl_label_set_text(lbl_link, "SGL Demo");
    sgl_label_set_font(lbl_link, &consolas14);
    sgl_label_set_text_color(lbl_link, CLR_CYBER_BLUE);
    sgl_obj_set_size(lbl_link, 60, 16);
    sgl_obj_set_pos(lbl_link, 24, 6);

    sgl_obj_t *lbl_date = sgl_label_create(root_page);
    char d_buff[16] = __DATE__;
    sgl_label_set_text(lbl_date, d_buff);
    sgl_label_set_font(lbl_date, &consolas14);
    sgl_label_set_text_color(lbl_date, CLR_CYBER_BLUE);
    sgl_obj_set_size(lbl_date, 80, 16);
    sgl_obj_set_pos(lbl_date, 150, 6);
    sgl_label_set_text_align(lbl_date, SGL_ALIGN_RIGHT_MID);

    // ---------------------------------------------------------
    // 2. Time 大时钟面板
    // ---------------------------------------------------------
    sgl_obj_t *time_r = sgl_rect_create(root_page);
    sgl_obj_set_pos(time_r, 10, 30);
    sgl_obj_set_size(time_r, 220, 70);
    sgl_rect_set_color(time_r, CLR_CARD_BG);
    sgl_rect_set_border_width(time_r, 1);
    sgl_rect_set_border_color(time_r, CLR_DIVIDER);
    sgl_rect_set_radius(time_r, 6);

    sgl_obj_t *lbl_time = sgl_label_create(time_r);
    sgl_label_set_font(lbl_time, &consolas56);
    sgl_label_set_text_color(lbl_time, CLR_TEXT);
    sgl_obj_set_size(lbl_time, 160, 70);
    sgl_obj_set_pos(lbl_time, 10, 0);
    sgl_label_set_text_align(lbl_time, SGL_ALIGN_CENTER);

    uint32_t sec = g_time_value % 86400;
    uint8_t hh = sec / 3600;
    uint8_t mm = (sec % 3600) / 60;
    uint8_t ss = sec % 60;
    char time_str1[16] = {0};
    sprintf(time_str1, "%02u:%02u", hh, mm);
    sgl_label_set_text(lbl_time, time_str1);

    sgl_obj_t *lbl_mon = sgl_label_create(time_r);
    sgl_label_set_text(lbl_mon, "THU");
    sgl_label_set_font(lbl_mon, &consolas18);
    sgl_label_set_text_color(lbl_mon, CLR_TEXT_GRAY);
    sgl_obj_set_size(lbl_mon, 30, 20);
    sgl_obj_set_pos(lbl_mon, 175, 10);

    sgl_obj_t *lbl_sec = sgl_label_create(time_r);
    sgl_label_set_font(lbl_sec, &consolas18);
    sgl_label_set_text_color(lbl_sec, CLR_TEXT_GRAY);
    sgl_obj_set_size(lbl_sec, 30, 20);
    sgl_obj_set_pos(lbl_sec, 175, 35);

    char time_str2[8] = {0};
    sprintf(time_str2, "%02u", ss);
    sgl_label_set_text(lbl_sec, time_str2);

    // ---------------------------------------------------------
    // 3. Env 温湿度卡片组
    // ---------------------------------------------------------
    // --- 3.1 左侧温度 ---
    sgl_obj_t *temp_r = sgl_rect_create(root_page);
    sgl_obj_set_size(temp_r, 106, 65);
    sgl_obj_set_pos(temp_r, 10, 110);
    sgl_rect_set_color(temp_r, CLR_CARD_BG);
    sgl_rect_set_border_width(temp_r, 1);
    sgl_rect_set_border_color(temp_r, CLR_DIVIDER);
    sgl_rect_set_radius(temp_r, 4);

    sgl_obj_t *lbl_t_title = sgl_label_create(temp_r);
    sgl_label_set_text(lbl_t_title, "TEMP");
    sgl_label_set_font(lbl_t_title, &consolas14);
    sgl_label_set_text_color(lbl_t_title, CLR_TEXT_GRAY);
    sgl_obj_set_size(lbl_t_title, 106, 16);
    sgl_obj_set_pos(lbl_t_title, 0, 0);

    sgl_obj_t *lbl_t_val = sgl_label_create(temp_r);
    char str_temp[16] = {0};
    sprintf(str_temp, "%d.%d", g_temp_value / 10, g_temp_value % 10);
    sgl_label_set_text(lbl_t_val, str_temp);
    sgl_label_set_font(lbl_t_val, &consolas32);
    sgl_label_set_text_color(lbl_t_val, CLR_NEON_GREEN);
    sgl_obj_set_size(lbl_t_val, 66, 40);
    sgl_obj_set_pos(lbl_t_val, 10, 14);

    sgl_obj_t *lbl_t_unit = sgl_label_create(temp_r);
    sgl_label_set_text(lbl_t_unit, " C");
    sgl_label_set_font(lbl_t_unit, &consolas18);
    sgl_label_set_text_color(lbl_t_unit, CLR_TEXT_GRAY);
    sgl_obj_set_size(lbl_t_unit, 40, 18);
    sgl_obj_set_pos(lbl_t_unit, 66, 30);

    // progress
    sgl_obj_t *t_line = sgl_bar_create(temp_r);
    sgl_obj_set_size(t_line, 86, 4);
    sgl_obj_set_pos(t_line, 10, 54);
    sgl_bar_set_value(t_line, g_temp_value / 10);
    sgl_bar_set_fill_color(t_line, CLR_NEON_GREEN);
    sgl_bar_set_track_color(t_line, CLR_DIVIDER);
    sgl_bar_set_border_width(t_line, 0);

    // --- 3.2 右侧湿度 ---
    sgl_obj_t *humi_r = sgl_rect_create(root_page);
    sgl_obj_set_size(humi_r, 106, 65);
    sgl_obj_set_pos(humi_r, 124, 110);
    sgl_rect_set_color(humi_r, CLR_CARD_BG);
    sgl_rect_set_border_width(humi_r, 1);
    sgl_rect_set_border_color(humi_r, CLR_DIVIDER);
    sgl_rect_set_radius(humi_r, 4);

    sgl_obj_t *lbl_h_title = sgl_label_create(humi_r);
    sgl_label_set_text(lbl_h_title, "HUMI");
    sgl_label_set_font(lbl_h_title, &consolas14);
    sgl_label_set_text_color(lbl_h_title, CLR_TEXT_GRAY);
    sgl_obj_set_size(lbl_h_title, 106, 16);
    sgl_obj_set_pos(lbl_h_title, 0, 0);

    sgl_obj_t *lbl_h_val = sgl_label_create(humi_r);
    char str_humi[16] = {0};
    sprintf(str_humi, "%d.%d", g_humi_value / 10, g_humi_value % 10);
    sgl_label_set_text(lbl_h_val, str_humi);
    sgl_label_set_font(lbl_h_val, &consolas32);
    sgl_label_set_text_color(lbl_h_val, CLR_CYBER_BLUE);
    sgl_obj_set_size(lbl_h_val, 66, 40);
    sgl_obj_set_pos(lbl_h_val, 10, 14);

    sgl_obj_t *lbl_h_unit = sgl_label_create(humi_r);
    sgl_label_set_text(lbl_h_unit, "%");
    sgl_label_set_font(lbl_h_unit, &consolas18);
    sgl_label_set_text_color(lbl_h_unit, CLR_TEXT_GRAY);
    sgl_obj_set_size(lbl_h_unit, 40, 18);
    sgl_obj_set_pos(lbl_h_unit, 66, 30);

    // progress
    sgl_obj_t *h_line = sgl_bar_create(humi_r);
    sgl_obj_set_size(h_line, 86, 4);
    sgl_obj_set_pos(h_line, 10, 54);
    sgl_bar_set_value(h_line, g_humi_value / 10);
    sgl_bar_set_fill_color(h_line, CLR_CYBER_BLUE);
    sgl_bar_set_track_color(h_line, CLR_DIVIDER);
    sgl_bar_set_border_width(h_line, 0);

    // ---------------------------------------------------------
    // 4. 底部控制区 & 图表
    // ---------------------------------------------------------
    // --- 主灯 (高亮边框) ---
    sgl_obj_t *light_r = sgl_rect_create(root_page);
    sgl_obj_set_size(light_r, 106, 55);
    sgl_obj_set_pos(light_r, 10, 185);
    sgl_rect_set_color(light_r, CLR_CARD_BG);
    sgl_rect_set_border_width(light_r, 1);
    sgl_rect_set_border_color(light_r, CLR_DIVIDER);
    sgl_rect_set_radius(light_r, 4);

    // light icon
    icon_light_r = sgl_icon_create(light_r);
    sgl_obj_set_size(icon_light_r, 40, 40);
    sgl_icon_set_icon(icon_light_r, &icon_light);
    sgl_icon_set_color(icon_light_r, CLR_TEXT_GRAY);
    sgl_obj_set_pos(icon_light_r, 0, 0);

    sgl_obj_t *lbl_light_val = sgl_label_create(light_r);
    sgl_label_set_text(lbl_light_val, "0");
    sgl_label_set_font(lbl_light_val, &consolas14);
    sgl_label_set_text_color(lbl_light_val, CLR_TEXT_GRAY);
    sgl_obj_set_size(lbl_light_val, 40, 15);
    sgl_obj_set_pos(lbl_light_val, 0, 40);

    sgl_obj_t *lbl_light = sgl_label_create(light_r);
    sgl_label_set_text(lbl_light, "LIGHT");
    sgl_label_set_font(lbl_light, &consolas18);
    sgl_label_set_text_color(lbl_light, CLR_TEXT_GRAY);
    sgl_obj_set_size(lbl_light, 60, 40);
    sgl_obj_set_pos(lbl_light, 40, 0);

    sgl_obj_t *slider_light = sgl_slider_create(light_r);
    sgl_obj_set_size(slider_light, 60, 8);
    sgl_obj_set_pos(slider_light, 40, 40);
    sgl_slider_set_value(slider_light, 20);
    sgl_slider_set_fill_color(slider_light, CLR_CYBER_BLUE);
    sgl_slider_set_knob_color(slider_light, CLR_NEON_GREEN);
    sgl_slider_set_track_color(slider_light, CLR_TEXT_GRAY);

    sgl_obj_set_event_cb(slider_light, light_cb, lbl_light_val);

    // --- 风扇 ---
    fan_r = sgl_rect_create(root_page);
    sgl_obj_set_size(fan_r, 49, 60);
    sgl_obj_set_pos(fan_r, 10, 248);
    sgl_rect_set_color(fan_r, CLR_CARD_BG);
    sgl_rect_set_border_width(fan_r, 1);
    sgl_rect_set_border_color(fan_r, CLR_DIVIDER);
    sgl_rect_set_radius(fan_r, 4);

    // fan icon
    sgl_obj_t *icon_fan_r = sgl_icon_create(fan_r);
    sgl_obj_set_size(icon_fan_r, 49, 32);
    sgl_icon_set_icon(icon_fan_r, &icon_fan);
    sgl_icon_set_color(icon_fan_r, CLR_TEXT_GRAY);
    sgl_obj_set_pos(icon_fan_r, 0, 4);

    fan_anim = sgl_anim_create();
    sgl_anim_set_data(fan_anim, icon_fan_r);
    sgl_anim_set_path(fan_anim, fan_anim_cb, sgl_anim_path_linear);
    sgl_anim_set_start_value(fan_anim, 0);
    sgl_anim_set_end_value(fan_anim, 2);
    sgl_anim_set_act_duration(fan_anim, 400);

    sgl_obj_t *lbl_fan = sgl_label_create(fan_r);
    sgl_label_set_text(lbl_fan, "FAN");
    sgl_label_set_font(lbl_fan, &consolas14);
    sgl_label_set_text_color(lbl_fan, CLR_TEXT_GRAY);
    sgl_obj_set_size(lbl_fan, 49, 28);
    sgl_obj_set_pos(lbl_fan, 0, 34);

    sgl_obj_set_event_cb(fan_r, fan_click_cb, icon_fan_r);

    // --- 锁 ---
    lock_r = sgl_rect_create(root_page);
    sgl_obj_set_size(lock_r, 49, 60);
    sgl_obj_set_pos(lock_r, 67, 248);
    sgl_rect_set_color(lock_r, CLR_CARD_BG);
    sgl_rect_set_border_width(lock_r, 1);
    sgl_rect_set_border_color(lock_r, CLR_DIVIDER);
    sgl_rect_set_radius(lock_r, 4);

    // fan icon
    sgl_obj_t *icon_lock_r = sgl_icon_create(lock_r);
    sgl_obj_set_size(icon_lock_r, 49, 32);
    sgl_icon_set_icon(icon_lock_r, &icon_lock);
    sgl_icon_set_color(icon_lock_r, CLR_TEXT_GRAY);
    sgl_obj_set_pos(icon_lock_r, 0, 4);

    sgl_obj_t *lbl_lock = sgl_label_create(lock_r);
    sgl_label_set_text(lbl_lock, "LOCK");
    sgl_label_set_font(lbl_lock, &consolas14);
    sgl_label_set_text_color(lbl_lock, CLR_TEXT_GRAY);
    sgl_obj_set_size(lbl_lock, 49, 28);
    sgl_obj_set_pos(lbl_lock, 0, 34);

    sgl_obj_set_event_cb(lock_r, lock_click_cb, icon_lock_r);

    // --- 右侧波形图 (MonkeyPi) ---
    sgl_obj_t *chart_r = sgl_rect_create(root_page);
    sgl_obj_set_size(chart_r, 106, 123);
    sgl_obj_set_pos(chart_r, 124, 185);
    sgl_rect_set_color(chart_r, CLR_CARD_BG);
    sgl_rect_set_border_width(chart_r, 1);
    sgl_rect_set_border_color(chart_r, CLR_DIVIDER);
    sgl_rect_set_radius(chart_r, 4);

    sgl_obj_t *lbl_c_title = sgl_label_create(chart_r);
    sgl_label_set_text(lbl_c_title, "@ MonkeyPi");
    sgl_label_set_font(lbl_c_title, &consolas14);
    sgl_label_set_text_color(lbl_c_title, CLR_TEXT);
    sgl_obj_set_size(lbl_c_title, 106, 20);
    sgl_obj_set_pos(lbl_c_title, 0, 0);

    // 绘制底部 Scope 波形组件
    sgl_obj_t *scope_dyn = sgl_scope_create(chart_r);
    sgl_obj_set_size(scope_dyn, 106, 100);
    sgl_obj_set_pos(scope_dyn, 0, 24);
    sgl_scope_set_range(scope_dyn, 0, 100);
    sgl_scope_set_bg_color(scope_dyn, CLR_PLOT_BG);
    sgl_scope_set_line_width(scope_dyn, 1);
    sgl_scope_set_waveform_color(scope_dyn, CLR_MAGENTA);
    sgl_scope_set_data_buffer(scope_dyn, g_plot_buff0, PLOT_BUFF_LEN);
    sgl_scope_enable_auto_scale(scope_dyn, true);
    sgl_scope_show_y_labels(scope_dyn, true);
    sgl_scope_set_y_label_color(scope_dyn, CLR_TEXT_GRAY);
    sgl_scope_set_y_label_font(scope_dyn, &consolas14);

    //////////////////////////////////////////////////

    uint32_t ticks_touch = HAL_GetTick();
    uint32_t ticks_led = HAL_GetTick();
    uint32_t ticks_seconds = HAL_GetTick();
    uint32_t plot_counter_index = 0;

    // HAL_Delay(5000);

    /* USER CODE END 2 */

    /* Infinite loop */
    /* USER CODE BEGIN WHILE */
    while (1)
    {
        /* USER CODE END WHILE */

        /* USER CODE BEGIN 3 */

        // sgl gui task
        sgl_task_handle();

        if ((HAL_GetTick() - ticks_touch) > 30)
        {
            ticks_touch = HAL_GetTick();

            // touch read
            touch_read_event();
        }

        if ((HAL_GetTick() - ticks_led) > 200)
        {
            ticks_led = HAL_GetTick();

            HAL_GPIO_TogglePin(LED_GPIO_Port, LED_Pin);

            // log_info("led toggle: %d", ticks_led);

            // monitor a value
            int8_t th = (ticks_led % 2) ? 1 : (-1);
            g_temp_value = g_temp_value + th * (ticks_led % 7) * 2;
            sprintf(str_temp, "%d.%d", g_temp_value / 10, g_temp_value % 10);
            sgl_label_set_text(lbl_t_val, str_temp);

            g_humi_value = g_humi_value + th * (ticks_led % 9) * 2;
            sprintf(str_humi, "%d.%d", g_humi_value / 10, g_humi_value % 10);
            sgl_label_set_text(lbl_h_val, str_humi);

            sgl_bar_set_value(t_line, g_temp_value / 10);
            sgl_bar_set_value(h_line, g_humi_value / 10);

            // plot to scope
            g_plot_value = (ticks_led % 10) * 10 + th * (ticks_led % 10);
            log_debug("plot value: %d", g_plot_value);

            uint32_t index = plot_counter_index % PLOT_BUFF_LEN;
            g_plot_buff0[index] = g_plot_value;
            sgl_scope_append_data(scope_dyn, g_plot_value);

            plot_counter_index++;
        }

        if ((HAL_GetTick() - ticks_seconds) > 1000)
        {
            ticks_seconds = HAL_GetTick();

            log_info("1 seconds");

            uint32_t sec = g_time_value % 86400;
            uint8_t hh = sec / 3600;
            uint8_t mm = (sec % 3600) / 60;
            uint8_t ss = sec % 60;

            char time_str1[16] = {0};
            sprintf(time_str1, "%02u:%02u", hh, mm);
            sgl_label_set_text(lbl_time, time_str1);

            char time_str2[8] = {0};
            sprintf(time_str2, "%02u", ss);
            sgl_label_set_text(lbl_sec, time_str2);

            g_time_value++;
        }
    }
    /* USER CODE END 3 */
}

/**
 * @brief System Clock Configuration
 * @retval None
 */
void SystemClock_Config(void)
{
    RCC_OscInitTypeDef RCC_OscInitStruct = {0};
    RCC_ClkInitTypeDef RCC_ClkInitStruct = {0};

    /** Configure the main internal regulator output voltage
     */
    HAL_PWREx_ControlVoltageScaling(PWR_REGULATOR_VOLTAGE_SCALE1);

    /** Initializes the RCC Oscillators according to the specified parameters
     * in the RCC_OscInitTypeDef structure.
     */
    RCC_OscInitStruct.OscillatorType = RCC_OSCILLATORTYPE_HSI;
    RCC_OscInitStruct.HSIState = RCC_HSI_ON;
    RCC_OscInitStruct.HSIDiv = RCC_HSI_DIV1;
    RCC_OscInitStruct.HSICalibrationValue = RCC_HSICALIBRATION_DEFAULT;
    RCC_OscInitStruct.PLL.PLLState = RCC_PLL_ON;
    RCC_OscInitStruct.PLL.PLLSource = RCC_PLLSOURCE_HSI;
    RCC_OscInitStruct.PLL.PLLM = RCC_PLLM_DIV1;
    RCC_OscInitStruct.PLL.PLLN = 8;
    RCC_OscInitStruct.PLL.PLLP = RCC_PLLP_DIV2;
    RCC_OscInitStruct.PLL.PLLR = RCC_PLLR_DIV2;
    if (HAL_RCC_OscConfig(&RCC_OscInitStruct) != HAL_OK)
    {
        Error_Handler();
    }

    /** Initializes the CPU, AHB and APB buses clocks
     */
    RCC_ClkInitStruct.ClockType = RCC_CLOCKTYPE_HCLK | RCC_CLOCKTYPE_SYSCLK | RCC_CLOCKTYPE_PCLK1;
    RCC_ClkInitStruct.SYSCLKSource = RCC_SYSCLKSOURCE_PLLCLK;
    RCC_ClkInitStruct.AHBCLKDivider = RCC_SYSCLK_DIV1;
    RCC_ClkInitStruct.APB1CLKDivider = RCC_HCLK_DIV1;

    if (HAL_RCC_ClockConfig(&RCC_ClkInitStruct, FLASH_LATENCY_2) != HAL_OK)
    {
        Error_Handler();
    }
}

/* USER CODE BEGIN 4 */

/* USER CODE END 4 */

/**
 * @brief  This function is executed in case of error occurrence.
 * @retval None
 */
void Error_Handler(void)
{
    /* USER CODE BEGIN Error_Handler_Debug */
    /* User can add his own implementation to report the HAL error return state */
    __disable_irq();
    while (1)
    {
    }
    /* USER CODE END Error_Handler_Debug */
}

#ifdef USE_FULL_ASSERT
/**
 * @brief  Reports the name of the source file and the source line number
 *         where the assert_param error has occurred.
 * @param  file: pointer to the source file name
 * @param  line: assert_param error line source number
 * @retval None
 */
void assert_failed(uint8_t *file, uint32_t line)
{
    /* USER CODE BEGIN 6 */
    /* User can add his own implementation to report the file name and line
       number, ex: printf("Wrong parameters value: file %s on line %d\r\n", file,
       line) */
    /* USER CODE END 6 */
}
#endif /* USE_FULL_ASSERT */
